## vivix-s/meta-vivix/conf/machine/imx8mm-vivix.conf
```bitbake
MACHINEOVERRIDES =. "imx8mm-vivix:"
require conf/machine/imx8mm-lpddr4-evk.conf
# Include device trees for other boards for internal test

#UBOOT_CONFIG = "imx8mm-vivix_defconfig,sd"
UBOOT_CONFIG_BASENAME = "imx8mm_vivix"


unset KERNEL_DEVICETREE

KERNEL_DEVICETREE = " \
    freescale/imx8mm-vivix.dtb \
"

IMAGE_FSTYPES = "cpio.gz"
#IMAGE_ROOTFS_EXTRA_SPACE= "300000"
```

## vivix-s/meta-vivix/recipes-bsp/u-boot/u-boot-imx/imx8mm_vivix/Kconfig
```kconfig
if TARGET_IMX8MM_VIVIX

config SYS_BOARD
	default "imx8mm_vivix"

config SYS_VENDOR
	default "freescale"

config SYS_CONFIG_NAME
	default "imx8mm_vivix"

config IMX_CONFIG
	default "board/freescale/imx8mm_vivix/imximage-8mm.cfg"

config IMX8M_1G_MEMORY
	bool "imx8m 1GB memory size"

endif
```
